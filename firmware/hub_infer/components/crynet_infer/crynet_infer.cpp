/*
 * CryNet — TFLite Micro inference implementation.
 *
 * Notes on three things that are easy to get wrong on the target:
 *
 *  1. The model byte array generated by the notebook has alignment 1, but
 *     a FlatBuffer must be aligned to its scalar width before it is read.
 *     Rather than change the generated header, the model is copied once
 *     at boot into a 16-byte aligned PSRAM buffer.
 *
 *  2. The tensor arena is the largest single allocation in the firmware.
 *     It goes to PSRAM when the board has it; the hub's 512 KB of
 *     internal SRAM is worth more to the radio, TFT and BLE stacks.
 *
 *  3. The output probabilities are dequantised with the *tensor's* own
 *     quantisation parameters, not with constants copied into the
 *     firmware, so the reported probability is always the one the model
 *     actually produced.
 */

#include "crynet_infer.h"

#include <new>
#include <stdint.h>
#include <stdio.h>
#include <string.h>

#include "esp_heap_caps.h"

#include "crynet_model.h"

#include "tensorflow/lite/micro/micro_interpreter.h"
#include "tensorflow/lite/micro/micro_mutable_op_resolver.h"
#include "tensorflow/lite/schema/schema_generated.h"

namespace {

/*
 * The notebook's hint is 120 KB. The arena is allocated with headroom
 * because the hint is an estimate of the *persistent* tensors only; the
 * allocator also needs scratch space for activations. If the model does
 * not fit, the failure is loud and measured rather than a silent
 * allocation error later.
 */
constexpr size_t kArenaBytes = 256 * 1024;

/* Number of ops the resolver can hold: conv, depthwise conv, max pool,
 * mean, fully connected, softmax. The selected conv_cnn model uses five
 * of them; depthwise conv is registered so the sep_cnn variant can be
 * dropped in without touching this file. */
constexpr size_t kResolverOps = 6;

}  // namespace

struct crynet_infer {
    void *interp_mem = nullptr;
    void *resolver_mem = nullptr;
    void *model_raw = nullptr;   /* unaligned base of the model allocation */
    uint8_t *arena = nullptr;
    size_t arena_bytes = 0;
    size_t arena_used = 0;
    bool ready = false;
    char error[192] = {0};

    tflite::MicroInterpreter *interp = nullptr;
    tflite::MicroMutableOpResolver<kResolverOps> *resolver = nullptr;
};

extern "C" {

crynet_infer_t *crynet_infer_create(void)
{
    auto *self = static_cast<crynet_infer_t *>(
        heap_caps_calloc(1, sizeof(crynet_infer_t),
                         MALLOC_CAP_8BIT | MALLOC_CAP_INTERNAL));
    if (self == nullptr) {
        return nullptr;
    }

    /* --- model, copied into an aligned buffer ------------------------ */
    const size_t model_len = crynet_model_size();
    /* The FlatBuffer verifier wants the model buffer aligned to 16 bytes.
     * heap_caps_malloc only guarantees 4-byte alignment, so over-allocate
     * by 16 bytes and align the copy by hand. */
    const size_t model_alloc = model_len + 16;
    void *model_raw = heap_caps_malloc(model_alloc, MALLOC_CAP_SPIRAM | MALLOC_CAP_8BIT);
    if (model_raw == nullptr) {
        model_raw = heap_caps_malloc(model_alloc, MALLOC_CAP_8BIT);
    }
    if (model_raw == nullptr) {
        snprintf(self->error, sizeof(self->error),
                 "cannot allocate %u bytes for the model", (unsigned)model_len);
        return self;
    }
    self->model_raw = model_raw;
    uint8_t *model_mem = reinterpret_cast<uint8_t *>(
        (reinterpret_cast<uintptr_t>(model_raw) + 15u) &
        ~static_cast<uintptr_t>(15u));
    memcpy(model_mem, crynet_model_bytes(), model_len);

    const tflite::Model *model = tflite::GetModel(model_mem);
    if (model->version() != TFLITE_SCHEMA_VERSION) {
        snprintf(self->error, sizeof(self->error),
                 "model schema %d, expected %d", (int)model->version(),
                 TFLITE_SCHEMA_VERSION);
        return self;
    }

    /* --- tensor arena ----------------------------------------------- */
    self->arena = static_cast<uint8_t *>(
        heap_caps_malloc(kArenaBytes, MALLOC_CAP_SPIRAM | MALLOC_CAP_8BIT));
    if (self->arena == nullptr) {
        self->arena = static_cast<uint8_t *>(
            heap_caps_malloc(kArenaBytes, MALLOC_CAP_8BIT));
    }
    if (self->arena == nullptr) {
        snprintf(self->error, sizeof(self->error),
                 "cannot allocate a %u byte tensor arena", (unsigned)kArenaBytes);
        return self;
    }
    self->arena_bytes = kArenaBytes;

    /* --- interpreter ------------------------------------------------- */
    self->resolver_mem = heap_caps_calloc(1, sizeof(*self->resolver),
                                          MALLOC_CAP_8BIT | MALLOC_CAP_INTERNAL);
    self->interp_mem = heap_caps_calloc(1, sizeof(*self->interp),
                                         MALLOC_CAP_8BIT | MALLOC_CAP_INTERNAL);
    if (self->resolver_mem == nullptr || self->interp_mem == nullptr) {
        snprintf(self->error, sizeof(self->error), "cannot allocate the interpreter");
        return self;
    }

    self->resolver = new (self->resolver_mem) tflite::MicroMutableOpResolver<kResolverOps>();
    self->resolver->AddConv2D();
    self->resolver->AddDepthwiseConv2D();
    self->resolver->AddMaxPool2D();
    self->resolver->AddMean();
    self->resolver->AddFullyConnected();
    self->resolver->AddSoftmax();

    self->interp = new (self->interp_mem) tflite::MicroInterpreter(
        model, *self->resolver, self->arena, self->arena_bytes);

    if (self->interp->AllocateTensors() != kTfLiteOk) {
        snprintf(self->error, sizeof(self->error),
                 "AllocateTensors failed (arena %u bytes)", (unsigned)self->arena_bytes);
        return self;
    }

    /* The interpreter reports the high-water mark of the arena. */
    self->arena_used = self->interp->arena_used_bytes();

    self->ready = true;
    return self;
}

void crynet_infer_destroy(crynet_infer_t *inf)
{
    if (inf == nullptr) {
        return;
    }
    if (inf->interp != nullptr) {
        inf->interp->~MicroInterpreter();
        heap_caps_free(inf->interp_mem);
    }
    if (inf->resolver != nullptr) {
        inf->resolver->~MicroMutableOpResolver<kResolverOps>();
        heap_caps_free(inf->resolver_mem);
    }
    if (inf->arena != nullptr) {
        heap_caps_free(inf->arena);
    }
    if (inf->model_raw != nullptr) {
        heap_caps_free(inf->model_raw);
    }
    heap_caps_free(inf);
}

bool crynet_infer_run(crynet_infer_t *inf,
                      const int8_t *features,
                      float *p_no_cry,
                      float *p_cry)
{
    if (inf == nullptr || !inf->ready || features == nullptr) {
        return false;
    }

    TfLiteTensor *input = inf->interp->input(0);
    if (input == nullptr || input->type != kTfLiteInt8) {
        snprintf(inf->error, sizeof(inf->error), "input tensor is not int8");
        return false;
    }
    if (input->bytes != CRYNET_N_FRAMES * CRYNET_N_MELS) {
        snprintf(inf->error, sizeof(inf->error),
                 "input tensor is %u bytes, expected %d",
                 (unsigned)input->bytes, CRYNET_N_FRAMES * CRYNET_N_MELS);
        return false;
    }

    memcpy(input->data.int8, features, input->bytes);

    if (inf->interp->Invoke() != kTfLiteOk) {
        snprintf(inf->error, sizeof(inf->error), "Invoke failed");
        return false;
    }

    const TfLiteTensor *output = inf->interp->output(0);
    if (output == nullptr || output->type != kTfLiteInt8 || output->bytes != 2) {
        snprintf(inf->error, sizeof(inf->error), "unexpected output tensor");
        return false;
    }

    const float scale = output->params.scale;
    const int32_t zero_point = output->params.zero_point;
    const float p0 = (static_cast<float>(output->data.int8[0]) - zero_point) * scale;
    const float p1 = (static_cast<float>(output->data.int8[1]) - zero_point) * scale;

    if (p_no_cry != nullptr) {
        *p_no_cry = p0;
    }
    if (p_cry != nullptr) {
        *p_cry = p1;
    }
    return true;
}

size_t crynet_infer_arena_bytes(const crynet_infer_t *inf)
{
    return inf != nullptr ? inf->arena_bytes : 0;
}

size_t crynet_infer_arena_used(const crynet_infer_t *inf)
{
    return inf != nullptr ? inf->arena_used : 0;
}

const char *crynet_infer_error(const crynet_infer_t *inf)
{
    return inf != nullptr ? inf->error : "no interpreter";
}

bool crynet_infer_ready(const crynet_infer_t *inf)
{
    return inf != nullptr && inf->ready;
}

}  // extern "C"
